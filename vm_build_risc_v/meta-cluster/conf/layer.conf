## vm_build_risc_v/meta-cluster/conf/layer.conf
```bitbake
# We have a conf and classes directory, add to BBPATH
BBPATH .= ":${LAYERDIR}"

# We have recipes-* directories, add to BBFILES
BBFILES += "${LAYERDIR}/recipes-*/*/*.bb \
            ${LAYERDIR}/recipes-*/*/*.bbappend"

BBFILE_COLLECTIONS += "meta-cluster"
BBFILE_PATTERN_meta-cluster = "^${LAYERDIR}/"
BBFILE_PRIORITY_meta-cluster = "6"

LAYERDEPENDS_meta-cluster = "core"
LAYERSERIES_COMPAT_meta-cluster = "kirkstone walnascar whinlatter scarthgap"
```

## vm_build_risc_v/meta-licheepi4a/conf/layer.conf
```bitbake
BBPATH .= ":${LAYERDIR}"

BBFILES += " \
    ${LAYERDIR}/recipes-*/*/*.bb \
    ${LAYERDIR}/recipes-*/*/*.bbappend \
"

BBFILE_COLLECTIONS += "meta-licheepi4a"
BBFILE_PATTERN_meta-licheepi4a = "^${LAYERDIR}/"
BBFILE_PRIORITY_meta-licheepi4a = "10"

LAYERDEPENDS_meta-licheepi4a = "core openembedded-layer"
LAYERSERIES_COMPAT_meta-licheepi4a = "kirkstone scarthgap"
```

## vm_build_risc_v/meta-licheepi4a/conf/machine/licheepi4a.conf
```bitbake
#@TYPE: Machine
#@NAME: Lichee Pi 4A
#@DESCRIPTION: Machine configuration for Lichee Pi 4A (T-Head TH1520 SoC)

require conf/machine/include/riscv/tune-riscv.inc

DEFAULTTUNE = "riscv64"
TUNE_FEATURES:tune-riscv64 = "riscv64"

MACHINE_FEATURES = "screen keyboard usbhost usbgadget wifi bluetooth ext2 ext3 serial ethernet"

PREFERRED_PROVIDER_virtual/kernel = "linux-revyos-th1520"
KERNEL_IMAGETYPE = "Image"
KERNEL_DEVICETREE = "thead/th1520-lichee-pi-4a.dtb"

PREFERRED_PROVIDER_virtual/bootloader = "u-boot-thead"
UBOOT_MACHINE = "light_lpi4a_defconfig"

RISCV_SBI_PLAT = "generic"
RISCV_SBI_FDT = "thead/th1520-lichee-pi-4a.dtb"

EXTRA_IMAGEDEPENDS += "opensbi-thead firmware-th1520 u-boot-thead"

SERIAL_CONSOLES = "115200;ttyS0"

MACHINE_ESSENTIAL_EXTRA_RRECOMMENDS += " \
    kernel-modules \
"

IMAGE_FSTYPES = "ext4 wic.gz"
IMAGE_BOOT_FILES = " \
    fw_dynamic.bin \
    ${KERNEL_IMAGETYPE} \
    th1520-lichee-pi-4a.dtb \
    light_aon_fpga.bin \
"

WKS_FILE ?= "licheepi4a-sdcard.wks"
WIC_CREATE_EXTRA_ARGS ?= "--no-fstab-update"
WKS_FILE_DEPENDS ?= " \
    opensbi-thead \
    e2fsprogs-native \
    bmaptool-native \
"

MACHINEOVERRIDES =. "licheepi4a:"
```

## vm_build_risc_v/meta-licheepi4a/wic/licheepi4a-sdcard.wks
```
# WKS file for Lichee Pi 4A SD card / eMMC image
# Layout matches RevyOS fastboot partition scheme:
#   - boot partition: fw_dynamic.bin, Image, DTB, light_aon_fpga.bin
#   - root partition: ext4 rootfs

part /boot --source bootimg-partition --ondisk mmcblk0 --fstype=ext4 --label boot --active --align 4096 --size 200M
part / --source rootfs --ondisk mmcblk0 --fstype=ext4 --label root --align 4096
```
